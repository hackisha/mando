/*@!Encoding:65001*/
includes { }

variables
{
  message Fault_sts_Rsp Fault_sts_Rsp_msg; // ID: 0x556
  message Fault_sts_Req Fault_sts_Req_msg; // ID: 0x555

  const long kSYNC_TIMEOUT = 10; 
}

on message Fault_sts_Rsp
{
  Fault_sts_Rsp_msg = this;
}

// -----------------------------------------------------------------
// [Helper Functions] 2번 코드(Baseline) 흐름 100% 동일 유지
// -----------------------------------------------------------------

// 1. 초기 환경 설정
void setupPreCondition(long engineSts, long battPercent, long ignSts)
{
  @sysvar::ENG::Sys_ENG_10ms_En = 1;
  @sysvar::ENG::Sys_IGN_2ms_En = 1;
  @sysvar::BMS::Sys_BMS_10ms_En = 1;
  @sysvar::STR::Sys_STR_10ms_En = 0;
  @sysvar::BRK::Sys_BRK_10ms_En = 0;

  @sysvar::ENG::Sys_Engine_sts = engineSts;
  @sysvar::BMS::Sys_Batt_Percent = battPercent;
  @sysvar::ENG::Sys_Ignition_sts = ignSts; // IGN 상태 주입

  Fault_sts_Req_msg.All_Fault_clr_request = 0;
  Fault_sts_Req_msg.All_Fault_sts_request = 0;
  output(Fault_sts_Req_msg);

  testWaitForTimeout(100); 
}

// 2. 결함 초기화
void initializeFaultState()
{
  testStep("Init", "결함 초기화 시퀀스 시작");

  // 정상 범위 세팅 (Engine Run, Batt 60%, IGN On)
  @sysvar::ENG::Sys_Engine_sts = 1;
  @sysvar::BMS::Sys_Batt_Percent = 60;
  @sysvar::ENG::Sys_Ignition_sts = 1; 
  testWaitForTimeout(100); 

  Fault_sts_Req_msg.All_Fault_clr_request = 1;
  output(Fault_sts_Req_msg);
  testWaitForTimeout(100); 
  
  Fault_sts_Req_msg.All_Fault_clr_request = 0;
  output(Fault_sts_Req_msg);
  testWaitForTimeout(100); 

  if(!requestAndVerifyLevel("Init_Verify", 0)) {
    testStepFail("Init", "결함 초기화 실패.");
  }
}

// 3. [싱크 주입] Baseline 흐름: 요청 -> 응답 대기 -> 주입
void syncAndInject(long eng, long batt, long ign)
{
  char logBuf[512];
  
  Fault_sts_Req_msg.All_Fault_sts_request = 1;
  output(Fault_sts_Req_msg);
  
  if (testWaitForMessage(Fault_sts_Rsp, kSYNC_TIMEOUT)) {
    testStep("Sync", "ECU Cycle 동기화 완료.");
  }
  
  Fault_sts_Req_msg.All_Fault_sts_request = 0;
  output(Fault_sts_Req_msg);

  @sysvar::ENG::Sys_Engine_sts = eng;
  @sysvar::BMS::Sys_Batt_Percent = batt;
  @sysvar::ENG::Sys_Ignition_sts = ign; 

  snprintf(logBuf, 512, "[주입] Engine:%ld, Battery:%ld%%, IGN:%ld", eng, batt, ign);
  testStep("Injection", logBuf);
}

// 4. [검증] Baseline 흐름: 20ms 대기 -> 요청 -> 데이터 박제 확인
int requestAndVerifyLevel(char stepId[], long expectedLevel)
{
  char logBuf[512];
  message Fault_sts_Rsp rxMsg; 

  testWaitForTimeout(10); 

  Fault_sts_Req_msg.All_Fault_sts_request = 1;
  output(Fault_sts_Req_msg);

  if (testWaitForMessage(Fault_sts_Rsp, kSYNC_TIMEOUT))
  {
    testGetWaitEventMsgData(rxMsg); 

    Fault_sts_Req_msg.All_Fault_sts_request = 0;
    output(Fault_sts_Req_msg);

    if (rxMsg.BATT_Chg_Err_sts == expectedLevel) {
      snprintf(logBuf, 512, "[성공] 예상:%ld, 실제:%ld", expectedLevel, (long)rxMsg.BATT_Chg_Err_sts);
      testStepPass(stepId, logBuf);
      return 1;
    } else {
      snprintf(logBuf, 512, "[실패] 예상:%ld, 실제:%ld", expectedLevel, (long)rxMsg.BATT_Chg_Err_sts);
      testStepFail(stepId, logBuf);
      return 0;
    }
  }
  
  Fault_sts_Req_msg.All_Fault_sts_request = 0;
  output(Fault_sts_Req_msg);
  testStepFail(stepId, "ECU 응답 타임아웃");
  return 0;
}

// -----------------------------------------------------------------
// [Test Cases] 요구사항 테이블(image_c21de3.png) 전체 구현
// -----------------------------------------------------------------

// --- 사전조건 (Pre-Condition) ---
testcase TC_PRE_01() {
  testCaseTitle("TC_PRE_01", "사전조건: Engine Off 시 미검출");
  initializeFaultState();
  syncAndInject(0, 60, 3); // Off, 60, Error
  testWaitForTimeout(120);
  requestAndVerifyLevel("Check", 0);
}

testcase TC_PRE_02() {
  testCaseTitle("TC_PRE_02", "사전조건: 배터리 경계값 미달(39%) 미검출");
  initializeFaultState();
  syncAndInject(1, 39, 3); 
  testWaitForTimeout(120);
  requestAndVerifyLevel("Check", 0);
}

testcase TC_PRE_03() {
  testCaseTitle("TC_PRE_03", "사전조건: 배터리 경계값 초과(81%) 미검출");
  initializeFaultState();
  syncAndInject(1, 81, 3); 
  testWaitForTimeout(120);
  requestAndVerifyLevel("Check", 0);
}

// --- 검출 조건 (Detection Condition) ---
testcase TC_DET_PRE_BVA_01() {
  testCaseTitle("TC_DET_PRE_BVA_01", "사전조건 최소 경계값 만족 시 검출(40%)");
  initializeFaultState();
  syncAndInject(1, 40, 3); 
  testWaitForTimeout(120);
  requestAndVerifyLevel("Check", 2);
}

testcase TC_DET_PRE_BVA_02() {
  testCaseTitle("TC_DET_PRE_BVA_02", "사전조건 최대 경계값 만족 시 검출(80%)");
  initializeFaultState();
  syncAndInject(1, 80, 3); 
  testWaitForTimeout(120);
  requestAndVerifyLevel("Check", 2);
}

testcase TC_DET_COND_01() {
  testCaseTitle("TC_DET_COND_01", "정상 상태 유지 확인(IGN On)");
  initializeFaultState();
  syncAndInject(1, 60, 1); 
  testWaitForTimeout(120);
  requestAndVerifyLevel("Check", 0);
}

testcase TC_DET_COND_02() {
  testCaseTitle("TC_DET_COND_02", "Error 상태 대표값 검출 확인");
  initializeFaultState();
  syncAndInject(1, 60, 3); 
  testWaitForTimeout(120);
  requestAndVerifyLevel("Check", 2);
}

// --- 검출 시간 (Detection Timing: 100ms) ---
testcase TC_DET_TIM_01() {
  testCaseTitle("TC_DET_TIM_01", "검출 최소시간 미달(89ms)");
  initializeFaultState();
  syncAndInject(1, 60, 3);
  testWaitForTimeout(89);
  requestAndVerifyLevel("Check", 0);
}

testcase TC_DET_TIM_02() {
  testCaseTitle("TC_DET_TIM_02", "검출 허용시간 도달(110ms)");
  initializeFaultState();
  syncAndInject(1, 60, 3);
  testWaitForTimeout(110);
  requestAndVerifyLevel("Check", 2);
}

// --- 회복 조건 (Recovery Condition) ---
testcase TC_REC_COND_01() {
  testCaseTitle("TC_REC_COND_01", "에러 유지 시 회복 불가 확인");
  initializeFaultState();
  syncAndInject(1, 60, 3);
  testWaitForTimeout(110);
  if(!requestAndVerifyLevel("FaultCheck", 2)) return;

  syncAndInject(1, 60, 3); 
  testWaitForTimeout(120);
  requestAndVerifyLevel("Check", 2);
}

testcase TC_REC_COND_02() {
  testCaseTitle("TC_REC_COND_02", "정상 상태 도달 시 회복 확인");
  initializeFaultState();
  syncAndInject(1, 60, 3);
  testWaitForTimeout(110);
  requestAndVerifyLevel("FaultCheck", 2);

  syncAndInject(1, 60, 1); 
  testWaitForTimeout(120);
  requestAndVerifyLevel("Check", 1);
}

// --- 회복 시간 (Recovery Timing: 100ms) ---
testcase TC_REC_TIM_01() {
  testCaseTitle("TC_REC_TIM_01", "회복 최소시간 미달(89ms)");
  initializeFaultState();
  syncAndInject(1, 60, 3);
  testWaitForTimeout(110);
  requestAndVerifyLevel("FaultCheck", 2);

  syncAndInject(1, 60, 1);
  testWaitForTimeout(89);
  requestAndVerifyLevel("Check", 2);
}

testcase TC_REC_TIM_02() {
  testCaseTitle("TC_REC_TIM_02", "회복 허용시간 도달(110ms)");
  initializeFaultState();
  syncAndInject(1, 60, 3);
  testWaitForTimeout(110);
  requestAndVerifyLevel("FaultCheck", 2);

  syncAndInject(1, 60, 1);
  testWaitForTimeout(110);
  requestAndVerifyLevel("Check", 1);
}

// -----------------------------------------------------------------
// [Main]
// -----------------------------------------------------------------
void mainTest()
{
  testModuleTitle("Ignition Status Error 정밀 검증");
  
  setupPreCondition(1, 60, 1); 

  TC_PRE_01(); TC_PRE_02(); TC_PRE_03();
  TC_DET_PRE_BVA_01(); TC_DET_PRE_BVA_02();
  TC_DET_COND_01(); TC_DET_COND_02();
  TC_DET_TIM_01(); TC_DET_TIM_02();
  TC_REC_COND_01(); TC_REC_COND_02();
  TC_REC_TIM_01(); TC_REC_TIM_02();
}
