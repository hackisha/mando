/*@!Encoding:65001*/
includes { }

variables
{
  message Fault_sts_Rsp Fault_sts_Rsp_msg; // ID: 0x556
  message Fault_sts_Req Fault_sts_Req_msg; // ID: 0x555

  const long kSYNC_TIMEOUT = 10; 
}

on message Fault_sts_Rsp
{
  Fault_sts_Rsp_msg = this;
}


// 1. 초기 환경 설정 및 주기 메시지 엔진 활성화
void setupPreCondition(long engineSts, long ignitionSts, long battPercent)
{
  @sysvar::ENG::Sys_ENG_10ms_En = 1;
  @sysvar::ENG::Sys_IGN_2ms_En = 1;
  @sysvar::BMS::Sys_BMS_10ms_En = 1;
  @sysvar::STR::Sys_STR_10ms_En = 0;
  @sysvar::BRK::Sys_BRK_10ms_En = 0;

  @sysvar::ENG::Sys_Engine_sts = engineSts;
  @sysvar::ENG::Sys_Ignition_sts = ignitionSts;
  @sysvar::BMS::Sys_Batt_Percent = battPercent;

  Fault_sts_Req_msg.All_Fault_clr_request = 0;
  Fault_sts_Req_msg.All_Fault_sts_request = 0;
  output(Fault_sts_Req_msg);

  testWaitForTimeout(100); 
}

// 2. 결함 초기화 시퀀스
void initializeFaultState()
{
  testStep("Init", "Battery Percent 초기화 시작");

  @sysvar::BMS::Sys_Batt_Percent = 50; // 정상 범위(50%) 세팅
  testWaitForTimeout(100); 

  Fault_sts_Req_msg.All_Fault_clr_request = 1;
  output(Fault_sts_Req_msg);
  testWaitForTimeout(100); 
  
  Fault_sts_Req_msg.All_Fault_clr_request = 0;
  output(Fault_sts_Req_msg);
  testWaitForTimeout(100); 

  if(!requestAndVerifyLevel("Init_Verify", 0)) {
    testStepFail("Init", "초기화 실패. 현재 Fault Level이 0이 아닙니다.");
  }
}

// 3. [싱크 주입] Baseline 흐름: 요청 -> 응답 대기 -> 주입
void syncAndInject(long eng, long ign, long batt)
{
  char logBuf[512];
  
  Fault_sts_Req_msg.All_Fault_sts_request = 1;
  output(Fault_sts_Req_msg);
  
  if (testWaitForMessage(Fault_sts_Rsp, kSYNC_TIMEOUT)) {
    testStep("Sync", "ECU Cycle 동기화 완료.");
  }
  
  Fault_sts_Req_msg.All_Fault_sts_request = 0;
  output(Fault_sts_Req_msg);

  @sysvar::ENG::Sys_Engine_sts = eng;
  @sysvar::ENG::Sys_Ignition_sts = ign;
  @sysvar::BMS::Sys_Batt_Percent = batt; 

  snprintf(logBuf, 512, "[주입] Engine:%ld, IGN:%ld, Battery:%ld%%", eng, ign, batt);
  testStep("Injection", logBuf);
}

// 4. [검증] Baseline 흐름: 10ms 대기 -> 요청 
int requestAndVerifyLevel(char stepId[], long expectedLevel)
{
  char logBuf[512];
  message Fault_sts_Rsp rxMsg; 

  testWaitForTimeout(10); //wait time

  Fault_sts_Req_msg.All_Fault_sts_request = 1;
  output(Fault_sts_Req_msg);

  if (testWaitForMessage(Fault_sts_Rsp, kSYNC_TIMEOUT))
  {
    testGetWaitEventMsgData(rxMsg); 

    Fault_sts_Req_msg.All_Fault_sts_request = 0;
    output(Fault_sts_Req_msg);

    if (rxMsg.BATT_Percent_Err_sts == expectedLevel) {
      snprintf(logBuf, 512, "[성공] 예상:%ld, 실제:%ld", expectedLevel, (long)rxMsg.BATT_Percent_Err_sts);
      testStepPass(stepId, logBuf);
      return 1;
    } else {
      snprintf(logBuf, 512, "[실패] 예상:%ld, 실제:%ld", expectedLevel, (long)rxMsg.BATT_Percent_Err_sts);
      testStepFail(stepId, logBuf);
      return 0;
    }
  }
  
  Fault_sts_Req_msg.All_Fault_sts_request = 0;
  output(Fault_sts_Req_msg);
  testStepFail(stepId, "ECU 응답 타임아웃");
  return 0;
}

// --- 1. 사전조건 (Precondition) ---
testcase TC_PRE_01() {
  testCaseTitle("PRE_01", "사전조건: Engine Off 시 검출 안됨");
  setupPreCondition(0, 1, 50);
  initializeFaultState();
  syncAndInject(0, 1, 14); 
  testWaitForTimeout(5100);
  requestAndVerifyLevel("Check", 0); 
}

testcase TC_PRE_02() {
  testCaseTitle("PRE_02", "사전조건: Ignition Off 시 검출 안됨");
  setupPreCondition(1, 0, 50);
  initializeFaultState();
  syncAndInject(1, 0, 14);
  testWaitForTimeout(5100);
  requestAndVerifyLevel("Check", 0);
}

// --- 2. 검출 조건 (Detection Condition) ---
testcase TC_DET_COND_01() {
  testCaseTitle("DET_COND_01", "검출조건: 16% (정상 범위) 유지 확인");
  initializeFaultState();
  syncAndInject(1, 1, 16);
  testWaitForTimeout(5100);
  requestAndVerifyLevel("Check", 0);
}

testcase TC_DET_COND_02() {
  testCaseTitle("DET_COND_02", "검출조건: 14% (결함 범위) 검출 확인");
  initializeFaultState();
  syncAndInject(1, 1, 14);
  testWaitForTimeout(5100);
  requestAndVerifyLevel("Check", 2);
}

testcase TC_DET_BVA_15_Fault()
{
  testCaseTitle("DET_BVA_15", "결함 경계값 검출 확인 (15%)");
  initializeFaultState();
  syncAndInject(1, 1, 15); // 딱 경계값 주입
  testWaitForTimeout(5100); 
  requestAndVerifyLevel("Check", 2); // 결함(2) 발생해야 함
}

// --- 3. 검출 시간 경계값 (4890ms ~ 5110ms) ---
testcase TC_DET_TIM_01_LowerLimit() {
  testCaseTitle("DET_TIM_01", "검출시간: 4890ms 시점 미검출 확인 (하한 경계)");
  initializeFaultState();
  syncAndInject(1, 1, 14);
  testWaitForTimeout(4890);
  requestAndVerifyLevel("Check", 0);
}

testcase TC_DET_TIM_02_UpperLimit() {
  testCaseTitle("DET_TIM_02", "검출시간: 5110ms 시점 확정 확인 (상한 경계)");
  initializeFaultState();
  syncAndInject(1, 1, 14);
  testWaitForTimeout(5110);
  requestAndVerifyLevel("Check", 2);
}

// --- 4. 회복 조건 (Recovery Condition) ---
testcase TC_REC_COND_01() {
  testCaseTitle("REC_COND_01", "회복조건: 29%에서 회복 안됨 확인");
  initializeFaultState();
  syncAndInject(1, 1, 10);
  testWaitForTimeout(5100);
  if(!requestAndVerifyLevel("Fault_Check", 2)) return;

  syncAndInject(1, 1, 29);
  testWaitForTimeout(100);
  requestAndVerifyLevel("Recovery_Check", 2);
}

testcase TC_REC_COND_02() {
  testCaseTitle("REC_COND_02", "회복조건: 30%에서 회복(Level 1) 확인");
  initializeFaultState();
  syncAndInject(1, 1, 10);
  testWaitForTimeout(5100);
  requestAndVerifyLevel("Fault_Check", 2);

  syncAndInject(1, 1, 30);
  testWaitForTimeout(120);
  requestAndVerifyLevel("Recovery_Check", 1);
}

// --- 5. 회복 시간 경계값 (Recovery Timing) ---
testcase TC_REC_TIM_01() {
  testCaseTitle("REC_TIM_01", "회복시간: 90ms 이전 미회복 확인");
  initializeFaultState();
  syncAndInject(1, 1, 10);
  testWaitForTimeout(5100);
  requestAndVerifyLevel("Fault_Check", 2);

  syncAndInject(1, 1, 30);
  testWaitForTimeout(80);
  requestAndVerifyLevel("Recovery_Check", 2);
}

testcase TC_REC_TIM_02() {
  testCaseTitle("REC_TIM_02", "회복시간: 110ms 시점 회복 확인");
  initializeFaultState();
  syncAndInject(1, 1, 10);
  testWaitForTimeout(5100);
  requestAndVerifyLevel("Fault_Check", 2);

  syncAndInject(1, 1, 30);
  testWaitForTimeout(110);
  requestAndVerifyLevel("Recovery_Check", 1);
}

void mainTest()
{
  testModuleTitle("Battery Percent Fault Full Baseline Refactoring");
  
  setupPreCondition(1, 1, 50); 

  // 순차적 테스트 실행
  TC_PRE_01();
  TC_PRE_02();
  
  TC_DET_COND_01();
  TC_DET_BVA_15_Fault();
  TC_DET_COND_02();
  
  TC_DET_TIM_01_LowerLimit();
  TC_DET_TIM_02_UpperLimit();
  
  TC_REC_COND_01();
  TC_REC_COND_02();
  
  TC_REC_TIM_01();
  TC_REC_TIM_02();
}
