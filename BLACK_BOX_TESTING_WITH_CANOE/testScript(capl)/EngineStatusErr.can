/*@!Encoding:65001*/
includes { }

variables
{
  // [메시지 정의]
  message Fault_sts_Rsp Fault_sts_Rsp_msg; // ID: 0x556
  message Fault_sts_Req Fault_sts_Req_msg; // ID: 0x555

  const long kSYNC_TIMEOUT = 10; 
}

on message Fault_sts_Rsp
{
  Fault_sts_Rsp_msg = this;
}

// -----------------------------------------------------------------
// [Helper Functions] 2번 코드(Baseline) 흐름 100% 동일 유지
// -----------------------------------------------------------------

// 1. 초기 환경 설정
void setupPreCondition(long ignSts, long battPercent, long engineSts)
{
  @sysvar::ENG::Sys_ENG_10ms_En = 1;
  @sysvar::ENG::Sys_IGN_2ms_En = 1;
  @sysvar::BMS::Sys_BMS_10ms_En = 1;
  @sysvar::STR::Sys_STR_10ms_En = 0;
  @sysvar::BRK::Sys_BRK_10ms_En = 0;

  @sysvar::ENG::Sys_Ignition_sts = ignSts;      // 1:On, 0:Off
  @sysvar::BMS::Sys_Batt_Percent = battPercent;
  @sysvar::ENG::Sys_Engine_sts = engineSts; // 1:Run, 2:Fault

  Fault_sts_Req_msg.All_Fault_clr_request = 0;
  Fault_sts_Req_msg.All_Fault_sts_request = 0;
  output(Fault_sts_Req_msg);

  testWaitForTimeout(100); 
}

// 2. 결함 초기화
void initializeFaultState()
{
  testStep("Init", "결함 초기화 시퀀스 시작");

  // 정상 범위 세팅 (IGN On, Batt 50%, Engine Run)
  @sysvar::ENG::Sys_Ignition_sts = 1;
  @sysvar::BMS::Sys_Batt_Percent = 50;
  @sysvar::ENG::Sys_Engine_sts = 1; 
  testWaitForTimeout(100); 

  Fault_sts_Req_msg.All_Fault_clr_request = 1;
  output(Fault_sts_Req_msg);
  testWaitForTimeout(100); 
  
  Fault_sts_Req_msg.All_Fault_clr_request = 0;
  output(Fault_sts_Req_msg);
  testWaitForTimeout(100); 

  if(!requestAndVerifyLevel("Init_Verify", 0)) {
    testStepFail("Init", "결함 초기화 실패.");
  }
}

// 3. [싱크 주입] Baseline 흐름: 요청 -> 응답 대기 -> 주입
void syncAndInject(long ign, long batt, long eng)
{
  char logBuf[512];
  
  Fault_sts_Req_msg.All_Fault_sts_request = 1;
  output(Fault_sts_Req_msg);
  
  if (testWaitForMessage(Fault_sts_Rsp, kSYNC_TIMEOUT)) {
    testStep("Sync", "ECU Cycle 동기화 완료.");
  }
  
  Fault_sts_Req_msg.All_Fault_sts_request = 0;
  output(Fault_sts_Req_msg);

  @sysvar::ENG::Sys_Ignition_sts = ign;
  @sysvar::BMS::Sys_Batt_Percent = batt;
  @sysvar::ENG::Sys_Engine_sts = eng; 

  snprintf(logBuf, 512, "[주입] IGN:%ld, Batt:%ld%%, Engine:%ld", ign, batt, eng);
  testStep("Injection", logBuf);
}

// 4. [검증] Baseline 흐름: 20ms 대기 -> 요청 -> 데이터 박제 확인
int requestAndVerifyLevel(char stepId[], long expectedLevel)
{
  char logBuf[512];
  message Fault_sts_Rsp rxMsg; 

  testWaitForTimeout(10); 

  Fault_sts_Req_msg.All_Fault_sts_request = 1;
  output(Fault_sts_Req_msg);

  if (testWaitForMessage(Fault_sts_Rsp, kSYNC_TIMEOUT))
  {
    testGetWaitEventMsgData(rxMsg); 

    Fault_sts_Req_msg.All_Fault_sts_request = 0;
    output(Fault_sts_Req_msg);

    if (rxMsg.BATT_Chg_Err_sts == expectedLevel) {
      snprintf(logBuf, 512, "[성공] 예상:%ld, 실제:%ld", expectedLevel, (long)rxMsg.BATT_Chg_Err_sts);
      testStepPass(stepId, logBuf);
      return 1;
    } else {
      snprintf(logBuf, 512, "[실패] 예상:%ld, 실제:%ld", expectedLevel, (long)rxMsg.BATT_Chg_Err_sts);
      testStepFail(stepId, logBuf);
      return 0;
    }
  }
  
  Fault_sts_Req_msg.All_Fault_sts_request = 0;
  output(Fault_sts_Req_msg);
  testStepFail(stepId, "ECU 응답 타임아웃");
  return 0;
}

// -----------------------------------------------------------------
// [Test Cases] 요구사항 테이블(image_c22604.png) 전체 구현
// -----------------------------------------------------------------

// --- 사전조건 (검출) ---
testcase TC_DET_PRE_01() {
  testCaseTitle("TC_DET_PRE_01", "사전조건: IGN Off 시 미검출");
  initializeFaultState();
  syncAndInject(0, 50, 2); // IGN Off, 50%, Fault
  testWaitForTimeout(1120);
  requestAndVerifyLevel("Check", 0);
}

testcase TC_DET_PRE_02() {
  testCaseTitle("TC_DET_PRE_02", "사전조건: 배터리 최소 미달(39%) 미검출");
  initializeFaultState();
  syncAndInject(1, 39, 2); 
  testWaitForTimeout(1120);
  requestAndVerifyLevel("Check", 0);
}

testcase TC_DET_PRE_03() {
  testCaseTitle("TC_DET_PRE_03", "사전조건: 배터리 최대 초과(61%) 미검출");
  initializeFaultState();
  syncAndInject(1, 61, 2); 
  testWaitForTimeout(1120);
  requestAndVerifyLevel("Check", 0);
}

// --- 검출 조건 ---
testcase TC_DET_BVA_01() {
  testCaseTitle("TC_DET_BVA_01", "검출조건: 최소 경계값(40%) 검출");
  initializeFaultState();
  syncAndInject(1, 40, 2); 
  testWaitForTimeout(1120);
  requestAndVerifyLevel("Check", 2);
}

testcase TC_DET_BVA_02() {
  testCaseTitle("TC_DET_BVA_02", "검출조건: 최대 경계값(60%) 검출");
  initializeFaultState();
  syncAndInject(1, 60, 2); 
  testWaitForTimeout(1120);
  requestAndVerifyLevel("Check", 2);
}

testcase TC_DET_COND_01() {
  testCaseTitle("TC_DET_COND_01", "검출조건: 정상 상태 유지(Engine Run)");
  initializeFaultState();
  syncAndInject(1, 50, 1); 
  testWaitForTimeout(1120);
  requestAndVerifyLevel("Check", 0);
}

// --- 검출 시간 ---
testcase TC_DET_TIM_01() {
  testCaseTitle("TC_DET_TIM_01", "검출시간: 오차 최소 미달(890ms)");
  initializeFaultState();
  syncAndInject(1, 50, 2);
  testWaitForTimeout(890);
  requestAndVerifyLevel("Check", 0);
}

testcase TC_DET_TIM_02() {
  testCaseTitle("TC_DET_TIM_02", "검출시간: 오차 최대 도달(1100ms)");
  initializeFaultState();
  syncAndInject(1, 50, 2);
  testWaitForTimeout(1100);
  requestAndVerifyLevel("Check", 2);
}

// --- 사전조건 (회복) ---
testcase TC_REC_PRE_01() {
  testCaseTitle("TC_REC_PRE_01", "회복조건: 배터리 최소 미달(39%) 고장 유지");
  initializeFaultState();
  syncAndInject(1, 50, 2); // 먼저 고장 발생
  testWaitForTimeout(1100);
  if(!requestAndVerifyLevel("PreCheck", 2)) return;

  syncAndInject(1, 39, 1); // 조건 미달 전압 주입
  testWaitForTimeout(120);
  requestAndVerifyLevel("Check", 2);
}

testcase TC_REC_PRE_02() {
  testCaseTitle("TC_REC_PRE_02", "회복조건: 배터리 최대 초과(81%) 고장 유지");
  initializeFaultState();
  syncAndInject(1, 50, 2);
  testWaitForTimeout(1100);
  requestAndVerifyLevel("PreCheck", 2);

  syncAndInject(1, 81, 1); 
  testWaitForTimeout(120);
  requestAndVerifyLevel("Check", 2);
}

// --- 회복 조건 ---
testcase TC_REC_BVA_01() {
  testCaseTitle("TC_REC_BVA_01", "회복조건: 최대 경계값(80%) 회복");
  initializeFaultState();
  syncAndInject(1, 50, 2);
  testWaitForTimeout(1100);
  requestAndVerifyLevel("PreCheck", 2);

  syncAndInject(1, 80, 1); 
  testWaitForTimeout(120);
  requestAndVerifyLevel("Check", 1);
}

testcase TC_REC_COND_01() {
  testCaseTitle("TC_REC_COND_01", "회복조건: 고장 상태 유지 시 미회복");
  initializeFaultState();
  syncAndInject(1, 50, 2);
  testWaitForTimeout(1100);
  requestAndVerifyLevel("PreCheck", 2);

  syncAndInject(1, 50, 2); // 에러 유지
  testWaitForTimeout(120);
  requestAndVerifyLevel("Check", 2);
}

// --- 회복 시간 ---
testcase TC_REC_TIM_01() {
  testCaseTitle("TC_REC_TIM_01", "회복시간: 오차 최소 미달(89ms)");
  initializeFaultState();
  syncAndInject(1, 50, 2);
  testWaitForTimeout(1100);
  requestAndVerifyLevel("PreCheck", 2);

  syncAndInject(1, 50, 1);
  testWaitForTimeout(89);
  requestAndVerifyLevel("Check", 2);
}

testcase TC_REC_TIM_02() {
  testCaseTitle("TC_REC_TIM_02", "회복시간: 오차 최대 도달(110ms)");
  initializeFaultState();
  syncAndInject(1, 50, 2);
  testWaitForTimeout(1100);
  requestAndVerifyLevel("PreCheck", 2);

  syncAndInject(1, 50, 1);
  testWaitForTimeout(110);
  requestAndVerifyLevel("Check", 1);
}

// -----------------------------------------------------------------
// [Main]
// -----------------------------------------------------------------
void mainTest()
{
  testModuleTitle("Engine Status Error 정밀 검증");
  
  setupPreCondition(1, 50, 1); 

  TC_DET_PRE_01(); TC_DET_PRE_02(); TC_DET_PRE_03();
  TC_DET_BVA_01(); TC_DET_BVA_02();
  TC_DET_COND_01();
  TC_DET_TIM_01(); TC_DET_TIM_02();
  TC_REC_PRE_01(); TC_REC_PRE_02();
  TC_REC_BVA_01();
  TC_REC_COND_01();
  TC_REC_TIM_01(); TC_REC_TIM_02();
}
