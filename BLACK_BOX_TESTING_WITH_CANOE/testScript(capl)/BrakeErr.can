/*@!Encoding:65001*/
includes { }

variables
{
  // [메시지 정의]
  message Fault_sts_Rsp Fault_sts_Rsp_msg; // ID: 0x556 (ECU -> Tester)
  message Fault_sts_Req Fault_sts_Req_msg; // ID: 0x555 (Tester -> ECU)

  const long kSYNC_TIMEOUT = 10; 
}

on message Fault_sts_Rsp
{
  Fault_sts_Rsp_msg = this;
}

// -----------------------------------------------------------------
// [Helper Functions] 정밀 싱크 및 시그널 매핑 수정
// -----------------------------------------------------------------

// 1. 초기 환경 설정 (주기 메시지 활성화 포함)
void setupPreCondition(long eng, long ign, long brk, long acc, long spd)
{
  // 주기 메시지 전송 엔진 활성화 (반드시 필요)
  @sysvar::ENG::Sys_ENG_10ms_En = 1;
  @sysvar::ENG::Sys_IGN_2ms_En = 1;
  @sysvar::BMS::Sys_BMS_10ms_En = 1;
  
  @sysvar::STR::Sys_STR_10ms_En = 0;
  @sysvar::BRK::Sys_BRK_10ms_En = 1;

  // 상태 주입
  @sysvar::ENG::Sys_Engine_sts = eng;
  @sysvar::ENG::Sys_Ignition_sts = ign;
  
  // 시스템 변수 경로 확인 필요 (제공해주신 경로 기준 유지)
  @sysvar::BRK::Sys_Brake_press = brk;
  @sysvar::BRK::Sys_ACCEL_press = acc;
  @sysvar::BRK::Sys_Vehicle_Speed = spd;

  Fault_sts_Req_msg.All_Fault_clr_request = 0;
  Fault_sts_Req_msg.All_Fault_sts_request = 0;
  output(Fault_sts_Req_msg);

  testWaitForTimeout(150); // 환경 전파 및 안정화 시간 충분히 확보
}

// 2. 결함 초기화 (확실한 0점 조절)
void initializeFaultState()
{
  testStep("Init", "결함 초기화 및 정상 상태(0/0/0) 확인");

  @sysvar::BRK::Sys_Brake_press = 0;
  @sysvar::BRK::Sys_ACCEL_press = 0;
  @sysvar::BRK::Sys_Vehicle_Speed = 0;
  testWaitForTimeout(100); 

  Fault_sts_Req_msg.All_Fault_clr_request = 1;
  output(Fault_sts_Req_msg);
  testWaitForTimeout(100); 
  
  Fault_sts_Req_msg.All_Fault_clr_request = 0;
  output(Fault_sts_Req_msg);
  testWaitForTimeout(100); 

  // 초기화 후 검증 실패 시 테스트 중단하여 오탐 방지
  if(!requestAndVerifyLevel("Init_Check", 0, 0, 0)) {
    testStepFail("Init", "초기화 실패. 제어기 상태가 0이 아닙니다.");
  }
}

// 3. [싱크 주입] 요청 -> 응답 대기 -> 주입 (Baseline 정석)
void syncAndInject(long brk, long acc, long spd)
{
  char logBuf[512];
  
  Fault_sts_Req_msg.All_Fault_sts_request = 1;
  output(Fault_sts_Req_msg);
  
  if (testWaitForMessage(Fault_sts_Rsp, kSYNC_TIMEOUT)) {
    testStep("Sync", "ECU Cycle 동기화 완료.");
  }
  
  Fault_sts_Req_msg.All_Fault_sts_request = 0;
  output(Fault_sts_Req_msg);

  // 싱크 직후(다음 사이클 시작)에 값 주입
  @sysvar::BRK::Sys_Brake_press = brk;
  @sysvar::BRK::Sys_ACCEL_press = acc;
  @sysvar::BRK::Sys_Vehicle_Speed = spd; 

  snprintf(logBuf, 512, "[주입] Brk:%ld, Acc:%ld, Spd:%ld", brk, acc, spd);
  testStep("Injection", logBuf);
}

// 4. [검증] 시그널 명칭 정밀 수정
int requestAndVerifyLevel(char stepId[], long expBrk, long expAcc, long expSpd)
{
  char logBuf[512];
  message Fault_sts_Rsp rxMsg; 

  testWaitForTimeout(30); // ECU 연산 여유 시간 확보

  Fault_sts_Req_msg.All_Fault_sts_request = 1;
  output(Fault_sts_Req_msg);

  if (testWaitForMessage(Fault_sts_Rsp, kSYNC_TIMEOUT))
  {
    testGetWaitEventMsgData(rxMsg); 

    Fault_sts_Req_msg.All_Fault_sts_request = 0;
    output(Fault_sts_Req_msg);

    // [중요] 시그널 명칭이 DBC와 일치해야 함 (Brake_Err_sts -> BRK_Err_sts 등으로 확인 필요)
    if (rxMsg.Brake_Err_sts == expBrk && rxMsg.ACCEL_Err_sts == expAcc && rxMsg.Speed_Err_sts == expSpd) {
      snprintf(logBuf, 512, "[성공] 예상:[%ld/%ld/%ld], 실제:[%ld/%ld/%ld]", 
               expBrk, expAcc, expSpd, (long)rxMsg.Brake_Err_sts, (long)rxMsg.ACCEL_Err_sts, (long)rxMsg.Speed_Err_sts);
      testStepPass(stepId, logBuf);
      return 1;
    } else {
      snprintf(logBuf, 512, "[실패] 예상:[%ld/%ld/%ld], 실제:[%ld/%ld/%ld]", 
               expBrk, expAcc, expSpd, (long)rxMsg.Brake_Err_sts, (long)rxMsg.ACCEL_Err_sts, (long)rxMsg.Speed_Err_sts);
      testStepFail(stepId, logBuf);
      return 0;
    }
  }
  
  Fault_sts_Req_msg.All_Fault_sts_request = 0;
  output(Fault_sts_Req_msg);
  testStepFail(stepId, "ECU 응답 타임아웃");
  return 0;
}

// 5. IGN Cycle Helper
void performIgnCycles(int count)
{
  int i;
  for(i = 1; i <= count; i++)
  {
    @sysvar::ENG::Sys_Ignition_sts = 0; 
    testWaitForTimeout(100);
    @sysvar::ENG::Sys_Ignition_sts = 1; 
    testWaitForTimeout(100);
  }
}

// -----------------------------------------------------------------
// [Test Cases] 27개 전체 시나리오
// -----------------------------------------------------------------

testcase BRK_PRE_01() { testCaseTitle("BRK-PRE-01", "Engine Run 조건 미충족"); setupPreCondition(0, 1, 0, 0, 0); syncAndInject(127, 0, 100); testWaitForTimeout(510); requestAndVerifyLevel("Check", 0, 0, 0); }
testcase BRK_PRE_02() { testCaseTitle("BRK-PRE-02", "IGN On 조건 미충족"); setupPreCondition(1, 0, 0, 0, 0); syncAndInject(127, 0, 100); testWaitForTimeout(510); requestAndVerifyLevel("Check", 0, 0, 0); }

testcase BRK_DET_00() { testCaseTitle("BRK-DET-00", "정상 조합"); initializeFaultState(); syncAndInject(0, 0, 100); testWaitForTimeout(510); requestAndVerifyLevel("Check", 0, 0, 0); }
testcase BRK_DET_01() { testCaseTitle("BRK-DET-01", "Brake 단독 검출"); initializeFaultState(); syncAndInject(127, 0, 100); testWaitForTimeout(510); requestAndVerifyLevel("Check", 2, 0, 0); }
testcase BRK_DET_02() { testCaseTitle("BRK-DET-02", "ACCEL 단독 검출"); initializeFaultState(); syncAndInject(0, 127, 100); testWaitForTimeout(510); requestAndVerifyLevel("Check", 0, 2, 0); }
testcase BRK_DET_03() { testCaseTitle("BRK-DET-03", "Speed 단독 검출"); initializeFaultState(); syncAndInject(0, 0, 255); testWaitForTimeout(510); requestAndVerifyLevel("Check", 0, 0, 2); }
testcase BRK_DET_04() { testCaseTitle("BRK-DET-04", "Brake+ACCEL 동시 검출"); initializeFaultState(); syncAndInject(127, 127, 100); testWaitForTimeout(510); requestAndVerifyLevel("Check", 2, 2, 0); }
testcase BRK_DET_05() { testCaseTitle("BRK-DET-05", "Brake+Speed 동시 검출"); initializeFaultState(); syncAndInject(127, 0, 255); testWaitForTimeout(510); requestAndVerifyLevel("Check", 2, 0, 2); }
testcase BRK_DET_06() { testCaseTitle("BRK-DET-06", "ACCEL+Speed 동시 검출"); initializeFaultState(); syncAndInject(0, 127, 255); testWaitForTimeout(510); requestAndVerifyLevel("Check", 0, 2, 2); }
testcase BRK_DET_07() { testCaseTitle("BRK-DET-07", "3개 시그널 동시 검출"); initializeFaultState(); syncAndInject(127, 127, 255); testWaitForTimeout(510); requestAndVerifyLevel("Check", 2, 2, 2); }

testcase BRK_REC_S_01() { testCaseTitle("BRK-REC-S-01", "Brake 단독 회복"); initializeFaultState(); syncAndInject(127, 0, 100); testWaitForTimeout(510); requestAndVerifyLevel("Pre", 2, 0, 0); syncAndInject(0, 0, 100); testWaitForTimeout(110); requestAndVerifyLevel("Check", 1, 0, 0); }
testcase BRK_REC_S_02() { testCaseTitle("BRK-REC-S-02", "ACCEL 단독 회복"); initializeFaultState(); syncAndInject(0, 127, 100); testWaitForTimeout(510); requestAndVerifyLevel("Pre", 0, 2, 0); syncAndInject(0, 0, 100); testWaitForTimeout(110); requestAndVerifyLevel("Check", 0, 1, 0); }
testcase BRK_REC_S_03() { testCaseTitle("BRK-REC-S-03", "Speed 단독 회복"); initializeFaultState(); syncAndInject(0, 0, 255); testWaitForTimeout(510); requestAndVerifyLevel("Pre", 0, 0, 2); syncAndInject(0, 0, 100); testWaitForTimeout(110); requestAndVerifyLevel("Check", 0, 0, 1); }

testcase BRK_REC_M_00() { testCaseTitle("BRK-REC-M-00", "3개 동시 회복"); initializeFaultState(); syncAndInject(127, 127, 255); testWaitForTimeout(510); requestAndVerifyLevel("Pre", 2, 2, 2); syncAndInject(0, 0, 100); testWaitForTimeout(110); requestAndVerifyLevel("Check", 1, 1, 1); }
testcase BRK_REC_M_01() { testCaseTitle("BRK-REC-M-01", "Brake 유지, 나머지 회복"); initializeFaultState(); syncAndInject(127, 127, 255); testWaitForTimeout(510); requestAndVerifyLevel("Pre", 2, 2, 2); syncAndInject(127, 0, 100); testWaitForTimeout(110); requestAndVerifyLevel("Check", 2, 1, 1); }
testcase BRK_REC_M_02() { testCaseTitle("BRK-REC-M-02", "ACCEL 유지, 나머지 회복"); initializeFaultState(); syncAndInject(127, 127, 255); testWaitForTimeout(510); requestAndVerifyLevel("Pre", 2, 2, 2); syncAndInject(0, 127, 100); testWaitForTimeout(110); requestAndVerifyLevel("Check", 1, 2, 1); }
testcase BRK_REC_M_03() { testCaseTitle("BRK-REC-M-03", "Speed 유지, 나머지 회복"); initializeFaultState(); syncAndInject(127, 127, 255); testWaitForTimeout(510); requestAndVerifyLevel("Pre", 2, 2, 2); syncAndInject(0, 0, 255); testWaitForTimeout(110); requestAndVerifyLevel("Check", 1, 1, 2); }
testcase BRK_REC_M_04() { testCaseTitle("BRK-REC-M-04", "Speed만 회복"); initializeFaultState(); syncAndInject(127, 127, 255); testWaitForTimeout(510); requestAndVerifyLevel("Pre", 2, 2, 2); syncAndInject(127, 127, 100); testWaitForTimeout(110); requestAndVerifyLevel("Check", 2, 2, 1); }
testcase BRK_REC_M_05() { testCaseTitle("BRK-REC-M-05", "ACCEL만 회복"); initializeFaultState(); syncAndInject(127, 127, 255); testWaitForTimeout(510); requestAndVerifyLevel("Pre", 2, 2, 2); syncAndInject(127, 0, 255); testWaitForTimeout(110); requestAndVerifyLevel("Check", 2, 1, 2); }
testcase BRK_REC_M_06() { testCaseTitle("BRK-REC-M-06", "Brake만 회복"); initializeFaultState(); syncAndInject(127, 127, 255); testWaitForTimeout(510); requestAndVerifyLevel("Pre", 2, 2, 2); syncAndInject(0, 127, 255); testWaitForTimeout(110); requestAndVerifyLevel("Check", 1, 2, 2); }
testcase BRK_REC_M_07() { testCaseTitle("BRK-REC-M-07", "회복 조건 없음"); initializeFaultState(); syncAndInject(127, 127, 255); testWaitForTimeout(510); requestAndVerifyLevel("Pre", 2, 2, 2); syncAndInject(127, 127, 255); testWaitForTimeout(110); requestAndVerifyLevel("Check", 2, 2, 2); }

testcase BRK_BND_01() { testCaseTitle("BRK-BND-01", "검출 오차 최소 미달(480ms)"); initializeFaultState(); syncAndInject(127, 0, 100); testWaitForTimeout(480); requestAndVerifyLevel("Check", 0, 0, 0); }
testcase BRK_BND_02() { testCaseTitle("BRK-BND-02", "검출 오차 최대 도달(510ms)"); initializeFaultState(); syncAndInject(127, 0, 100); testWaitForTimeout(510); requestAndVerifyLevel("Check", 2, 0, 0); }
testcase BRK_BND_03() { testCaseTitle("BRK-BND-03", "회복 오차 최소 미달(80ms)"); initializeFaultState(); syncAndInject(127, 0, 100); testWaitForTimeout(510); requestAndVerifyLevel("Pre", 2, 0, 0); syncAndInject(0, 0, 100); testWaitForTimeout(80); requestAndVerifyLevel("Check", 2, 0, 0); }
testcase BRK_BND_04() { testCaseTitle("BRK-BND-04", "회복 오차 최대 도달(110ms)"); initializeFaultState(); syncAndInject(127, 0, 100); testWaitForTimeout(510); requestAndVerifyLevel("Pre", 2, 0, 0); syncAndInject(0, 0, 100); testWaitForTimeout(110); requestAndVerifyLevel("Check", 1, 0, 0); }

testcase BRK_DEL_01() { testCaseTitle("BRK-DEL-01", "49회 Cycle 후 Stored 유지"); initializeFaultState(); syncAndInject(127, 127, 255); testWaitForTimeout(510); syncAndInject(0, 0, 100); testWaitForTimeout(110); requestAndVerifyLevel("Store", 1, 1, 1); performIgnCycles(49); requestAndVerifyLevel("Final", 1, 1, 1); }
testcase BRK_DEL_02() { testCaseTitle("BRK-DEL-02", "50회 Cycle 후 Deleted 확정"); initializeFaultState(); syncAndInject(127, 127, 255); testWaitForTimeout(510); syncAndInject(0, 0, 100); testWaitForTimeout(110); requestAndVerifyLevel("Store", 1, 1, 1); performIgnCycles(50); requestAndVerifyLevel("Final", 0, 0, 0); }

// -----------------------------------------------------------------
// [Main]
// -----------------------------------------------------------------
void mainTest()
{
  testModuleTitle("Brake Error Chassis Group 정밀 검증 완본");

  // 사전조건 실행
  BRK_PRE_01(); BRK_PRE_02();
  
  // 검출을 위해 정상 구동 상태로 세팅 (Run, On, NoPress)
  setupPreCondition(1, 1, 0, 0, 100);
  
  // 나머지 TC 순차 실행
  BRK_DET_00(); BRK_DET_01(); BRK_DET_02(); BRK_DET_03(); BRK_DET_04(); BRK_DET_05(); BRK_DET_06(); BRK_DET_07();
  BRK_REC_S_01(); BRK_REC_S_02(); BRK_REC_S_03();
  BRK_REC_M_00(); BRK_REC_M_01(); BRK_REC_M_02(); BRK_REC_M_03(); BRK_REC_M_04(); BRK_REC_M_05(); BRK_REC_M_06(); BRK_REC_M_07();
  BRK_BND_01(); BRK_BND_02(); BRK_BND_03(); BRK_BND_04();
  BRK_DEL_01(); BRK_DEL_02();
}
