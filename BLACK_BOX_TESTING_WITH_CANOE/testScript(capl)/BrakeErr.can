/*@!Encoding:65001*/
includes { }

variables
{
  message Fault_sts_Rsp Fault_sts_Rsp_msg; // ID: 0x556
  message Fault_sts_Req Fault_sts_Req_msg; // ID: 0x555

  // -----------------------------------------------------------------
  // 💡 Configuration Variables (Tuning)
  // -----------------------------------------------------------------
  long gStbDelay = 10;     // 주입 및 요청 전 안정화 대기 시간 (ms)
  long gPollInterval = 10; // 측정 루프 내 상태 확인 주기 (ms)

  // 리포트 출력을 위한 현재 주입값 실시간 추적 변수 (상세 명칭)
  long curEngine = 0; 
  long curIgnition = 0;
  long curBrake = 0; 
  long curAccel = 0; 
  long curSpeed = 0;
  
  long g_lastDurationMs = 0; // 최근 응답 소요 시간

  // Signal Definitions
  const int SIG_BRAKE = 1;
  const int SIG_ACCEL = 2;
  const int SIG_SPEED = 3;
}

on message Fault_sts_Rsp
{
  Fault_sts_Rsp_msg = this;
}

// -----------------------------------------------------------------
// Helper Functions (Stability & Accuracy Optimized)
// -----------------------------------------------------------------

long getSignalStatus(int sigType)
{
  if (sigType == SIG_BRAKE) return Fault_sts_Rsp_msg.Brake_Err_sts;
  if (sigType == SIG_ACCEL) return Fault_sts_Rsp_msg.ACCEL_Err_sts;
  if (sigType == SIG_SPEED) return Fault_sts_Rsp_msg.Speed_Err_sts;
  return -1;
}

void setAllSignals(long bVal, long aVal, long sVal)
{
  curBrake = bVal; curAccel = aVal; curSpeed = sVal;
  @sysvar::BRK::Sys_Brake_press = bVal;
  @sysvar::BRK::Sys_ACCEL_press = aVal;
  @sysvar::BRK::Sys_Vehicle_Speed = sVal;
  
  testStep("Injection", "Action: [Brake:%d, Accel:%d, Speed:%d] 주입 (안정화 %d ms 대기)", bVal, aVal, sVal, gStbDelay);
  testWaitForTimeout(gStbDelay); 
}

void setSignalValue(int sigType, long val)
{
  if (sigType == SIG_BRAKE) { curBrake = val; @sysvar::BRK::Sys_Brake_press = val; }
  else if (sigType == SIG_ACCEL) { curAccel = val; @sysvar::BRK::Sys_ACCEL_press = val; }
  else if (sigType == SIG_SPEED) { curSpeed = val; @sysvar::BRK::Sys_Vehicle_Speed = val; }
  
  testStep("Injection", "Action: 단일 신호값 %d 설정 (안정화 %d ms 대기)", val, gStbDelay);
  testWaitForTimeout(gStbDelay); 
}

int requestFaultStatus(long timeoutMs)
{
  dword startTime;
  startTime = timeNow();
  Fault_sts_Req_msg.All_Fault_sts_request = 1;
  output(Fault_sts_Req_msg);

  if (testWaitForMessage(Fault_sts_Rsp, timeoutMs))
  {
    g_lastDurationMs = (timeNow() - startTime) / 100;
    testStep("Communication", "제어기 응답 수신: %d ms 소요", g_lastDurationMs);
    Fault_sts_Req_msg.All_Fault_sts_request = 0;
    output(Fault_sts_Req_msg);
    return 1;
  }
  Fault_sts_Req_msg.All_Fault_sts_request = 0;
  output(Fault_sts_Req_msg);
  return 0;
}

int verifyAllStatuses(char stepId[], long expB, long expA, long expS)
{
  testWaitForTimeout(gStbDelay); 
  if (!requestFaultStatus(100))
  {
    testStepFail(stepId, "오류: 응답 타임아웃 [Engine=%d, Ignition=%d, Brake=%d, Accel=%d, Speed=%d]", curEngine, curIgnition, curBrake, curAccel, curSpeed);
    return 0;
  }
  if (Fault_sts_Rsp_msg.Brake_Err_sts != expB || Fault_sts_Rsp_msg.ACCEL_Err_sts != expA || Fault_sts_Rsp_msg.Speed_Err_sts != expS)
  {
    testStepFail(stepId, "실패: 기대값 [B:%d, A:%d, S:%d] != 실제값 [B:%d, A:%d, S:%d]", expB, expA, expS, Fault_sts_Rsp_msg.Brake_Err_sts, Fault_sts_Rsp_msg.ACCEL_Err_sts, Fault_sts_Rsp_msg.Speed_Err_sts);
    return 0;
  }
  testStepPass(stepId, "성공: 모든 상태 일치 [Brake_Err:%d, Accel_Err:%d, Speed_Err:%d]", expB, expA, expS);
  return 1;
}

int verifyCurrentStatus(char stepId[], int sigType, long expected)
{
  long actual;
  testWaitForTimeout(gStbDelay); 
  if (!requestFaultStatus(100))
  {
    testStepFail(stepId, "오류: 응답 타임아웃 [Engine=%d, Ignition=%d, Brake=%d, Accel=%d, Speed=%d]", curEngine, curIgnition, curBrake, curAccel, curSpeed);
    return 0;
  }
  actual = getSignalStatus(sigType);
  if (actual != expected)
  {
    testStepFail(stepId, "실패: 기대 Level %d != 실제 Level %d [Engine=%d, Ignition=%d]", expected, actual, curEngine, curIgnition);
    return 0;
  }
  testStepPass(stepId, "성공: Level %d 확인됨 [Engine=%d, Ignition=%d, Brake=%d, Accel=%d, Speed=%d]", expected, curEngine, curIgnition, curBrake, curAccel, curSpeed);
  return 1;
}

long measureTimeAfterChange(int sigType, long val, long targetStatus, long maxWaitMs)
{
  dword startTime;
  startTime = timeNow();
  setSignalValue(sigType, val); 
  while (1)
  {
    testWaitForTimeout(gPollInterval); 
    if (((timeNow() - startTime) / 100) > maxWaitMs) break;
    if (requestFaultStatus(50))
    {
      if (getSignalStatus(sigType) == targetStatus) return (timeNow() - startTime) / 100;
    }
  }
  return -1;
}

int checkTimeLimit(char stepId[], long measuredMs, long minMs, long maxMs)
{
  if (measuredMs < 0) { testStepFail(stepId, "실패: %d ms 이내에 목표 상태 도달 못함 [Brake=%d, Accel=%d, Speed=%d]", maxMs, curBrake, curAccel, curSpeed); return 0; }
  if (measuredMs < minMs || measuredMs > maxMs) { testStepFail(stepId, "실패: 측정 시간 %d ms (허용범위: %d~%d ms) [Engine=%d, Ignition=%d]", measuredMs, minMs, maxMs, curEngine, curIgnition); return 0; }
  testStepPass(stepId, "성공: 정밀 타이밍 만족 (%d ms) [Engine=%d, Ignition=%d]", measuredMs, curEngine, curIgnition);
  return 1;
}

int checkStatusNotChangedAtTime(char stepId[], int sigType, long totalWaitMs, long unexpectedStatus)
{
  long actual;
  long calcWait;
  calcWait = totalWaitMs - gStbDelay;
  if (calcWait > 0) testWaitForTimeout(calcWait);
  if (!requestFaultStatus(100)) { testStepFail(stepId, "오류: 응답 타임아웃 [Engine=%d, Ignition=%d]", curEngine, curIgnition); return 0; }
  actual = getSignalStatus(sigType);
  if (actual == unexpectedStatus) { testStepFail(stepId, "실패: %d ms 시점에 조기 전이 발생 (Level %d)", totalWaitMs, unexpectedStatus); return 0; }
  testStepPass(stepId, "성공: %d ms 시점까지 Level %d 미발생 확인 [Engine=%d, IGN=%d, Brk=%d, Acc=%d, Spd=%d]", totalWaitMs, unexpectedStatus, curEngine, curIgnition, curBrake, curAccel, curSpeed);
  return 1;
}

int checkNoFaultForDuration(char stepId[], int sigType, long totalWaitMs)
{
  dword startTime;
  long elapsed;
  startTime = timeNow();
  while (1)
  {
    elapsed = (timeNow() - startTime) / 100;
    if (elapsed > totalWaitMs) break;
    if (!requestFaultStatus(100)) { testStepFail(stepId, "오류: 통신 타임아웃 [Engine=%d, IGN=%d]", curEngine, curIgnition); return 0; }
    if (getSignalStatus(sigType) == 2) { testStepFail(stepId, "실패: %d ms 시점에 조기 고장 검출", elapsed); return 0; }
    testWaitForTimeout(gPollInterval);
  }
  testStepPass(stepId, "성공: %d ms 동안 고장 미발생 확인 [Brake=%d, Accel=%d, Speed=%d]", totalWaitMs, curBrake, curAccel, curSpeed);
  return 1;
}

void setupPreCondition(long engineSts, long ignSts)
{
  curEngine = engineSts; curIgnition = ignSts;
  @sysvar::ENG::Sys_ENG_10ms_En = 1; @sysvar::ENG::Sys_IGN_2ms_En = 1; @sysvar::BRK::Sys_BRK_10ms_En = 1; 
  @sysvar::ENG::Sys_Engine_sts = engineSts; @sysvar::ENG::Sys_Ignition_sts = ignSts;
  setAllSignals(0, 0, 0);
  Fault_sts_Req_msg.All_Fault_clr_request = 1; output(Fault_sts_Req_msg);
  testWaitForTimeout(50);
  Fault_sts_Req_msg.All_Fault_clr_request = 0; output(Fault_sts_Req_msg);
  testWaitForTimeout(100);
}

int clearAndVerifyNoFault(char stepId[])
{
  Fault_sts_Req_msg.All_Fault_clr_request = 1; output(Fault_sts_Req_msg);
  testWaitForTimeout(50);
  Fault_sts_Req_msg.All_Fault_clr_request = 0; output(Fault_sts_Req_msg);
  testWaitForTimeout(gStbDelay);
  if (!requestFaultStatus(100)) { testStepFail(stepId, "오류: 초기화 후 타임아웃"); return 0; }
  testStepPass(stepId, "성공: 클리어 완료 [Engine=%d, Ignition=%d]", curEngine, curIgnition);
  return 1;
}

int setupAndClear(char clearStepId[], long engineSts, long ignSts)
{
  setupPreCondition(engineSts, ignSts);
  return clearAndVerifyNoFault(clearStepId);
}

// -----------------------------------------------------------------
// 1) General Preconditions
// -----------------------------------------------------------------

testcase TC_PRE_01_NoDetection_When_EngineIsOff()
{
  long waitVal;
  testStep("1.0", "Precondition: Engine Stop, Ignition On");
  if (!setupAndClear("1.1", 0, 1)) return;
  setSignalValue(SIG_BRAKE, 127);
  waitVal = 520 - gStbDelay;
  checkNoFaultForDuration("2.1", SIG_BRAKE, waitVal);
}

testcase TC_PRE_02_NoDetection_When_IgnitionIsOff()
{
  long waitVal;
  testStep("1.0", "Precondition: Engine Run, Ignition Off");
  if (!setupAndClear("1.1", 1, 0)) return;
  setSignalValue(SIG_BRAKE, 127);
  waitVal = 520 - gStbDelay;
  checkNoFaultForDuration("2.1", SIG_BRAKE, waitVal);
}

// -----------------------------------------------------------------
// 2) Individual Signal Exhaustive BVA & Timing
// -----------------------------------------------------------------

// --- Brake Cases ---
testcase TC_BRK_DET_BVA_01_NoFault_When_BrakeIs126()
{
  testStep("1.0", "Brake BVA: 126 주입 시 고장 미발생 검증");
  if (!setupAndClear("1.1", 1, 1)) return;
  setSignalValue(SIG_BRAKE, 126);
  checkNoFaultForDuration("2.1", SIG_BRAKE, 520 - gStbDelay);
}

testcase TC_BRK_DET_BVA_02_FaultDetected_When_BrakeIs127()
{
  long waitVal;
  testStep("1.0", "Brake BVA: 127 주입 시 고장 발생 검증");
  if (!setupAndClear("1.1", 1, 1)) return;
  setSignalValue(SIG_BRAKE, 127);
  waitVal = 520 - gStbDelay;
  testWaitForTimeout(waitVal);
  verifyCurrentStatus("2.0", SIG_BRAKE, 2);
}

testcase TC_BRK_DET_TIM_01_NoFaultBefore489ms()
{
  testStep("1.0", "Brake Timing: 489ms 이전 고장 미전이 검증");
  if (!setupAndClear("1.1", 1, 1)) return;
  setSignalValue(SIG_BRAKE, 127);
  checkStatusNotChangedAtTime("2.1", SIG_BRAKE, 489, 2);
}

testcase TC_BRK_DET_TIM_02_FaultWithin490To510ms()
{
  long detectMs;
  testStep("1.0", "Brake Timing: 500ms(+-10ms) 정밀 검출 시간 측정");
  if (!setupAndClear("1.1", 1, 1)) return;
  detectMs = measureTimeAfterChange(SIG_BRAKE, 127, 2, 530);
  checkTimeLimit("2.0", detectMs, 490, 510);
  verifyCurrentStatus("2.1", SIG_BRAKE, 2);
}

testcase TC_BRK_REC_BVA_01_Recovery_When_BrakeIs126()
{
  long waitVal;
  testStep("1.0", "Brake Recovery BVA: 126 주입 시 회복(Level 1) 검증");
  if (!setupAndClear("1.1", 1, 1)) return;
  setSignalValue(SIG_BRAKE, 127);
  testWaitForTimeout(520 - gStbDelay);
  if (!verifyCurrentStatus("1.2", SIG_BRAKE, 2)) return;
  
  setSignalValue(SIG_BRAKE, 126);
  waitVal = 120 - gStbDelay;
  testWaitForTimeout(waitVal);
  verifyCurrentStatus("2.1", SIG_BRAKE, 1);
}

testcase TC_BRK_REC_TIM_02_RecoveryWithin90To110ms()
{
  long recoverMs;
  testStep("1.0", "Brake Recovery Timing: 100ms(+-10ms) 정밀 회복 시간 측정");
  if (!setupAndClear("1.1", 1, 1)) return;
  setSignalValue(SIG_BRAKE, 127);
  testWaitForTimeout(520 - gStbDelay);
  
  recoverMs = measureTimeAfterChange(SIG_BRAKE, 126, 1, 150);
  checkTimeLimit("2.0", recoverMs, 90, 110);
  verifyCurrentStatus("2.1", SIG_BRAKE, 1);
}

// --- Accel Cases ---
testcase TC_ACC_DET_BVA_02_FaultDetected()
{
  testStep("1.0", "Accel BVA: 127 주입 시 고장 발생 검증");
  if (!setupAndClear("1.1", 1, 1)) return;
  setSignalValue(SIG_ACCEL, 127);
  testWaitForTimeout(520 - gStbDelay);
  verifyCurrentStatus("2.0", SIG_ACCEL, 2);
}

testcase TC_ACC_DET_TIM_02_Precision()
{
  long detectMs;
  testStep("1.0", "Accel Timing: 500ms 정밀 검출 검증");
  if (!setupAndClear("1.1", 1, 1)) return;
  detectMs = measureTimeAfterChange(SIG_ACCEL, 127, 2, 530);
  checkTimeLimit("2.0", detectMs, 490, 510);
  verifyCurrentStatus("2.1", SIG_ACCEL, 2);
}

testcase TC_ACC_REC_TIM_02_Precision()
{
  long recoverMs;
  testStep("1.0", "Accel Recovery Timing: 100ms 정밀 회복 검증");
  if (!setupAndClear("1.1", 1, 1)) return;
  setSignalValue(SIG_ACCEL, 127);
  testWaitForTimeout(520 - gStbDelay);
  recoverMs = measureTimeAfterChange(SIG_ACCEL, 126, 1, 150);
  checkTimeLimit("2.0", recoverMs, 90, 110);
}

// --- Speed Cases ---
testcase TC_SPD_DET_BVA_02_FaultDetected()
{
  testStep("1.0", "Speed BVA: 255 주입 시 고장 발생 검증");
  if (!setupAndClear("1.1", 1, 1)) return;
  setSignalValue(SIG_SPEED, 255);
  testWaitForTimeout(520 - gStbDelay);
  verifyCurrentStatus("2.0", SIG_SPEED, 2);
}

testcase TC_SPD_DET_TIM_02_Precision()
{
  long detectMs;
  testStep("1.0", "Speed Timing: 500ms 정밀 검출 검증");
  if (!setupAndClear("1.1", 1, 1)) return;
  detectMs = measureTimeAfterChange(SIG_SPEED, 255, 2, 530);
  checkTimeLimit("2.0", detectMs, 490, 510);
}

testcase TC_SPD_REC_TIM_02_Precision()
{
  long recoverMs;
  testStep("1.0", "Speed Recovery Timing: 100ms 정밀 회복 검증");
  if (!setupAndClear("1.1", 1, 1)) return;
  setSignalValue(SIG_SPEED, 255);
  testWaitForTimeout(520 - gStbDelay);
  recoverMs = measureTimeAfterChange(SIG_SPEED, 254, 1, 150);
  checkTimeLimit("2.0", recoverMs, 90, 110);
}

// -----------------------------------------------------------------
// 3) 💡 Combinatorial Matrices (Exhaustive 8x8 States)
// -----------------------------------------------------------------

testcase TC_MATRIX_Exhaustive_Detection_8_States()
{
  int i; long b, a, s; long expB, expA, expS; char stepId[20];
  testStep("DET_MATRIX", "=== 고장 검출 조합 매트릭스 테스트 (8가지) ===");
  for (i = 0; i < 8; i++) {
    b = (i & 0x01) ? 127 : 0; a = (i & 0x02) ? 127 : 0; s = (i & 0x04) ? 255 : 0;
    expB = (i & 0x01) ? 2 : 0; expA = (i & 0x02) ? 2 : 0; expS = (i & 0x04) ? 2 : 0;
    snprintf(stepId, 20, "DET_State_%d", i);
    setupPreCondition(1, 1); setAllSignals(b, a, s);
    testWaitForTimeout(510);
    verifyAllStatuses(stepId, expB, expA, expS);
  }
}

testcase TC_MATRIX_Exhaustive_Recovery_8_States()
{
  int i; long b, a, s; long expB, expA, expS; char stepId[20];
  testStep("REC_MATRIX", "=== 고장 회복 조합 매트릭스 테스트 (8가지) ===");
  for (i = 0; i < 8; i++) {
    setupPreCondition(1, 1); setAllSignals(127, 127, 255);
    testWaitForTimeout(510); 
    if (!verifyAllStatuses("REC_INIT", 2, 2, 2)) continue;

    b = (i & 0x01) ? 127 : 0; a = (i & 0x02) ? 127 : 0; s = (i & 0x04) ? 255 : 0;
    expB = (i & 0x01) ? 2 : 1; expA = (i & 0x02) ? 2 : 1; expS = (i & 0x04) ? 2 : 1;
    snprintf(stepId, 20, "REC_State_%d", i);
    setAllSignals(b, a, s);
    testWaitForTimeout(110); 
    verifyAllStatuses(stepId, expB, expA, expS);
  }
}

// -----------------------------------------------------------------
// Main Test Execution
// -----------------------------------------------------------------

void mainTest()
{
  testModuleTitle("Req 6: Ultimate Full Exhaustive Combinatorial Test");

  // A. Combinatorial Matrices
  TC_MATRIX_Exhaustive_Detection_8_States();
  TC_MATRIX_Exhaustive_Recovery_8_States();

  // B. Standard Detailed Test Cases (Expanded)
  TC_PRE_01_NoDetection_When_EngineIsOff();
  TC_PRE_02_NoDetection_When_IgnitionIsOff();

  TC_BRK_DET_BVA_01_NoFault_When_BrakeIs126();
  TC_BRK_DET_BVA_02_FaultDetected_When_BrakeIs127();
  TC_BRK_DET_TIM_01_NoFaultBefore489ms();
  TC_BRK_DET_TIM_02_FaultWithin490To510ms();
  TC_BRK_REC_BVA_01_Recovery_When_BrakeIs126();
  TC_BRK_REC_TIM_02_RecoveryWithin90To110ms();

  TC_ACC_DET_BVA_02_FaultDetected();
  TC_ACC_DET_TIM_02_Precision();
  TC_ACC_REC_TIM_02_Precision();

  TC_SPD_DET_BVA_02_FaultDetected();
  TC_SPD_DET_TIM_02_Precision();
  TC_SPD_REC_TIM_02_Precision();
}
